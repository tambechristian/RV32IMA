## zulu_a7/buildroot/configs/zulu_a7_rv32ima_defconfig
```kconfig
BR2_riscv=y
BR2_riscv_custom=y
BR2_RISCV_ISA_RVM=y
BR2_RISCV_ISA_RVA=y
BR2_RISCV_32=y
BR2_RISCV_USE_MMU=y
BR2_RISCV_ABI_ILP32=y
BR2_PACKAGE_HOST_LINUX_HEADERS_CUSTOM_6_18=y
BR2_TOOLCHAIN_BUILDROOT_MUSL=y
BR2_TARGET_OPTIMIZATION="-Os -pipe"
BR2_TARGET_GENERIC_HOSTNAME="zulu-a7-rv32ima"
BR2_TARGET_GENERIC_ISSUE="Zulu A7 RV32IMA Buildroot"
BR2_ROOTFS_DEVICE_CREATION_DYNAMIC_DEVTMPFS=y
BR2_TARGET_GENERIC_GETTY=y
BR2_TARGET_GENERIC_GETTY_PORT="ttyS0"
BR2_TARGET_GENERIC_GETTY_BAUDRATE_115200=y
BR2_TARGET_GENERIC_GETTY_TERM="vt100"
BR2_ROOTFS_POST_IMAGE_SCRIPT="$(BR2_EXTERNAL_ZULU_A7_RV32IMA_PATH)/board/zulu_a7/post-image.sh"
BR2_LINUX_KERNEL=y
BR2_LINUX_KERNEL_CUSTOM_VERSION=y
BR2_LINUX_KERNEL_CUSTOM_VERSION_VALUE="6.18.7"
BR2_LINUX_KERNEL_USE_DEFCONFIG=y
BR2_LINUX_KERNEL_DEFCONFIG="rv32"
BR2_LINUX_KERNEL_CONFIG_FRAGMENT_FILES="$(BR2_EXTERNAL_ZULU_A7_RV32IMA_PATH)/board/zulu_a7/linux.config.fragment"
BR2_LINUX_KERNEL_IMAGE=y
BR2_LINUX_KERNEL_DTS_SUPPORT=y
BR2_LINUX_KERNEL_CUSTOM_DTS_PATH="$(BR2_EXTERNAL_ZULU_A7_RV32IMA_PATH)/../dts/zulu_a7_rv32ima.dts"
BR2_TARGET_ROOTFS_INITRAMFS=y
BR2_TARGET_ROOTFS_CPIO_GZIP=y
# BR2_TARGET_ROOTFS_TAR is not set
BR2_TARGET_OPENSBI=y
BR2_TARGET_OPENSBI_CUSTOM_VERSION=y
BR2_TARGET_OPENSBI_CUSTOM_VERSION_VALUE="1.9"
BR2_TARGET_OPENSBI_PLAT="generic"
BR2_TARGET_OPENSBI_LINUX_PAYLOAD=y
BR2_TARGET_OPENSBI_ADDITIONAL_VARIABLES="FW_TEXT_START=0x80000000 FW_PAYLOAD_OFFSET=0x00400000 FW_PAYLOAD_FDT_ADDR=0x83e00000 FW_FDT_PATH=$(BINARIES_DIR)/zulu_a7_rv32ima.dtb PLATFORM_RISCV_ISA=rv32ima_zicsr_zifencei PLATFORM_RISCV_ABI=ilp32"
```
